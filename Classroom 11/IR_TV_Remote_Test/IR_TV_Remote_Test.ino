#include "IRremote.h" //IR remote library

IRsend irsend; //Initializing IR Emitter

//raw data arrays 

unsigned int  POWER[71] = {9050,4500, 550,550, 600,550, 550,550, 600,550, 550,550, 600,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2250, 600};

unsigned int  MUTE[71] = {9050,4500, 550,550, 600,550, 550,550, 600,550, 550,550, 600,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2250, 600};

unsigned int  VOLUP[71] = {9050,4450, 600,550, 600,550, 550,550, 600,550, 550,550, 600,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2250, 550};

unsigned int  VOLDOWN[71] = {9050,4500, 600,550, 550,550, 600,550, 550,550, 600,550, 600,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2200, 600};

unsigned int  CHUP[71] = {9100,4450, 600,550, 600,500, 600,550, 600,500, 600,550, 550,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2250, 600};

unsigned int  CHDOWN[71] = {9050,4500, 600,500, 600,550, 600,500, 600,550, 600,500, 600,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2250, 600};

void setup() {
  //Configuring the buttons and the 5-way switch as inputs
  pinMode(WIO_KEY_A, INPUT);
  pinMode(WIO_KEY_B, INPUT);
  pinMode(WIO_5S_UP, INPUT);
  pinMode(WIO_5S_DOWN, INPUT);
  pinMode(WIO_5S_LEFT, INPUT);
  pinMode(WIO_5S_RIGHT, INPUT);

}

void loop() {
  //power button 
  if (digitalRead(WIO_KEY_A) == LOW){ //Detecting the button press
    irsend.sendRaw(POWER,71,38); //Pass the array, array length, carrier frequency
    delay(1000);
  }
  //mute button 
  else if(digitalRead(WIO_KEY_B) == LOW){
    irsend.sendRaw(MUTE,71,38);
    delay(1000);
  }
  //volume up switch
  else if(digitalRead(WIO_5S_UP) == LOW){
    irsend.sendRaw(VOLUP,71,38);
    delay(1000);
  }
  //volume down switch 
  else if(digitalRead(WIO_5S_DOWN) == LOW){
    irsend.sendRaw(VOLDOWN,71,38);
    delay(1000);
  }
  //channel up switch 
  else if(digitalRead(WIO_5S_RIGHT) == LOW){
    irsend.sendRaw(CHUP,71,38);
    delay(1000);
  }
  //channel down switch
  else if(digitalRead(WIO_5S_LEFT) == LOW){
    irsend.sendRaw(CHDOWN,71,38);
    delay(1000);
  }

}
