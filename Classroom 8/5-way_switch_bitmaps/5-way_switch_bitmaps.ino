#include "TFT_eSPI.h" //include TFT LCD library 
#include "Seeed_FS.h" //include file system library 
#include"RawImage.h" //include raw image library

TFT_eSPI tft; //initialize TFT LCD

TFT_eSprite spr = TFT_eSprite(&tft); //initialize buffer

//bitmap to display UP arrow
const unsigned char UP[] = {
  0x00, 0x00, 0x00, 0x00, 0x00, 0x00, 0x00, 0x00, 0x00, 0x00, 0x00, 0x00, 
  0x00, 0x00, 0x00, 0x00, 0x00, 0x00, 0x00, 0x00, 0x00, 0x00, 0x00, 0x00, 
  0x00, 0x00, 0x00, 0x00, 0x00, 0x00, 0x00, 0x00, 0x00, 0x00, 0x00, 0x00, 
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  0x00, 0x00, 0x00, 0x00, 0x00, 0x00, 0x00, 0x00, 0x00, 0x00, 0x00, 0x00, 
  };


//bitmap to draw left arrow 
const unsigned char LEFT[] = {
  0x00, 0x00, 0x00, 0x00, 0x00, 0x00, 0x00, 0x00, 0x00, 0x00, 0x00, 0x00, 
  0x00, 0x00, 0x00, 0x00, 0x00, 0x00, 0x00, 0x00, 0x00, 0x00, 0x00, 0x00, 
  0x00, 0x00, 0x00, 0x00, 0x00, 0x00, 0x00, 0x00, 0x00, 0x00, 0x00, 0x00, 
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  0x00, 0x00, 0x00, 0x00, 0x00, 0x00, 0x00, 0x00, 0x00, 0x00, 0x00, 0x00, 
  };

void setup() {
  if (!SD.begin(SDCARD_SS_PIN, SDCARD_SPI)) { //check whether SD card is inserted and working 
        while (1);
    }
    
  tft.begin(); //start TFT LCD 
  tft.setRotation(3); //set screen rotation 
  spr.createSprite(TFT_HEIGHT,TFT_WIDTH); //create buffer 
  pinMode(WIO_5S_UP, INPUT); //set switch pin up as input 
  pinMode(WIO_5S_DOWN, INPUT); //set switch pin down as input 
  pinMode(WIO_5S_LEFT, INPUT); //set switch pin left as input 
  pinMode(WIO_5S_RIGHT, INPUT); //set switch pin right as input 
  pinMode(WIO_5S_PRESS, INPUT); //set switch pin press as input 
}
 
void loop() {
  tft.setTextSize(6); //set text size
  tft.setTextColor(TFT_RED); //set text color 

  if (digitalRead(WIO_5S_UP) == LOW) { //check whether switch is moved up 
   tft.setRotation(3); //set screen rotation
   tft.drawXBitmap(0,0,UP, 320, 240, TFT_WHITE); //display bitmap 
   delay(1000); //hold bitmap on screen
  }
  else if (digitalRead(WIO_5S_DOWN) == LOW) {
   tft.setRotation(1);
   tft.drawXBitmap(0,0,UP, 320, 240, TFT_WHITE);
   delay(1000);
  }
  else if (digitalRead(WIO_5S_LEFT) == LOW) {
   tft.setRotation(3);
   tft.drawXBitmap(0,0,LEFT, 320, 240, TFT_WHITE);
   delay(1000);
  }
  else if (digitalRead(WIO_5S_RIGHT) == LOW) {
   tft.setRotation(1);
   tft.drawXBitmap(0,0,LEFT, 320, 240, TFT_WHITE);
   delay(1000);
  }
  else if (digitalRead(WIO_5S_PRESS) == LOW) {
   tft.fillCircle(160,120,30,TFT_WHITE);
   delay(1000);
  }

  spr.pushSprite(0,0); //push to LCD 
  delay(200);

}
